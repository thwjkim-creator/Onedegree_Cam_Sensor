## sdkconfig.defaults
```kconfig
# -----------------------------------------------------------
# ESP32-CAM (AI-Thinker) + VEML7700  –  sdkconfig.defaults
# -----------------------------------------------------------

# ---------- Flash / Partition ----------
CONFIG_ESPTOOLPY_FLASHSIZE_4MB=y
CONFIG_PARTITION_TABLE_CUSTOM=y
CONFIG_PARTITION_TABLE_CUSTOM_FILENAME="partitions.csv"

# ---------- PSRAM (AI-Thinker uses PSRAM) ----------
CONFIG_ESP32_SPIRAM_SUPPORT=y
CONFIG_SPIRAM=y
CONFIG_SPIRAM_SPEED_80M=y
CONFIG_SPIRAM_TYPE_AUTO=y
CONFIG_SPIRAM_USE_CAPS_ALLOC=y
 
# ---------- Camera ----------
CONFIG_CAMERA_TASK_STACK_SIZE=4096
CONFIG_SCCB_HARDWARE_I2C_PORT0=y
CONFIG_SCCB_HARDWARE_I2C_PORT1=n

# ---------- FreeRTOS ----------
CONFIG_FREERTOS_HZ=1000

# ---------- LWIP ----------
CONFIG_LWIP_MAX_SOCKETS=16

# ---------- MQTT ----------
CONFIG_MQTT_PROTOCOL_311=y
CONFIG_MQTT_TRANSPORT_SSL=n

# ---------- HTTP Client ----------
CONFIG_ESP_HTTP_CLIENT_ENABLE_HTTPS=y
CONFIG_MBEDTLS_EXTERNAL_MEM_ALLOC=y

CONFIG_ESP_TLS_INSECURE=y
CONFIG_ESP_TLS_SKIP_SERVER_CERT_VERIFY=y

# CONFIG_MBEDTLS_DEBUG=y
# CONFIG_MBEDTLS_DEBUG_LEVEL_VERBOSE=y
# CONFIG_LOG_DEFAULT_LEVEL_DEBUG=y
# CONFIG_LOG_DEFAULT_LEVEL=4

# ---------- Log level ----------
CONFIG_LOG_DEFAULT_LEVEL_INFO=y
CONFIG_LOG_DEFAULT_LEVEL=3

# ---------- Wi-Fi ----------
CONFIG_ESP_WIFI_SOFTAP_SUPPORT=n

# ---------- Bluetooth (BLE provisioning) ----------
CONFIG_BT_ENABLED=y
CONFIG_BTDM_CTRL_MODE_BLE_ONLY=y
CONFIG_BT_BLE_ENABLED=y

# ---------- OTA ----------
CONFIG_BOOTLOADER_APP_ROLLBACK_ENABLE=y
```
